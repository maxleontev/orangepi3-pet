## build-orangepi3/conf/bblayers.conf
```bitbake
# POKY_BBLAYERS_CONF_VERSION is increased each time build/conf/bblayers.conf
# changes incompatibly
POKY_BBLAYERS_CONF_VERSION = "2"

BBPATH = "${TOPDIR}"
BBFILES ?= ""

LAYER_BASE := "${TOPDIR}/.."

BBLAYERS ?= " \
  ${LAYER_BASE}/poky/meta \
  ${LAYER_BASE}/poky/meta-poky \
  ${LAYER_BASE}/poky/meta-yocto-bsp \
  ${LAYER_BASE}/meta-openembedded/meta-oe \
  ${LAYER_BASE}/meta-openembedded/meta-networking \
  ${LAYER_BASE}/meta-openembedded/meta-python \
  ${LAYER_BASE}/meta-openembedded/meta-filesystems \
  ${LAYER_BASE}/meta-arm/meta-arm \
  ${LAYER_BASE}/meta-arm/meta-arm-toolchain \
  ${LAYER_BASE}/meta-sunxi \
  ${LAYER_BASE}/meta-local \
  "
```

## build-orangepi3/conf/local.conf
```bitbake
MACHINE ?= "orange-pi-3lts"
DISTRO ?= "poky"

PACKAGE_CLASSES ?= "package_deb"
#EXTRA_IMAGE_FEATURES ?= "allow-empty-password allow-root-login empty-root-password ssh-server-dropbear debug-tweaks"

EXTRA_IMAGE_FEATURES ?= "allow-empty-password allow-root-login empty-root-password"


BB_NUMBER_THREADS ?= "32"
PARALLEL_MAKE ?= "-j32"

DL_DIR ?= "${TOPDIR}/downloads"
SSTATE_DIR ?= "${TOPDIR}/sstate-cache"


BB_DISKMON_DIRS ??= "\
    STOPTASKS,${TMPDIR},1G,100K \
    STOPTASKS,${DL_DIR},1G,100K \
    STOPTASKS,${SSTATE_DIR},1G,100K \
    STOPTASKS,/tmp,100M,100K \
    HALT,${TMPDIR},100M,1K \
    HALT,${DL_DIR},100M,1K \
    HALT,${SSTATE_DIR},100M,1K \
    HALT,/tmp,10M,1K"


CONF_VERSION = "2"

BBMASK += "meta-sdr/recipes-applications/gqrx/"
BBMASK += "meta-sdr/recipes-core/gnuradio/"


INIT_MANAGER = "systemd"
DISTRO_FEATURES:append = " systemd "
VIRTUAL-RUNTIME_init_manager = "systemd"


# Force dropbear to allow passwords (remove -s flag)
# DROPBEAR_EXTRA_ARGS = "-r ${sysconfdir}/dropbear/dropbear_rsa_host_key"
```

## meta-local/conf/layer.conf
```bitbake
# We have a conf and classes directory, add to BBPATH
BBPATH .= ":${LAYERDIR}"

# We have recipes-* directories, add to BBFILES
BBFILES += "${LAYERDIR}/recipes-*/*/*.bb \
            ${LAYERDIR}/recipes-*/*/*.bbappend"

BBFILE_COLLECTIONS += "meta-local"
BBFILE_PATTERN_meta-local = "^${LAYERDIR}/"
BBFILE_PRIORITY_meta-local = "6"

LAYERDEPENDS_meta-local = "core"
LAYERSERIES_COMPAT_meta-local = "scarthgap"

ERROR_QA:remove = "patch-status"

# switch on wifi for ap6256
CONFIG_BRCMUTIL="y"
CONFIG_BRCMFMAC="y"
CONFIG_BRCMFMAC_SDIO="y"

IMAGE_INSTALL:append = " fw-ap6256"

IMAGE_INSTALL:append = " wpa-supplicant iw"

IMAGE_INSTALL:append = " wifi-init"
```
